// ************************************************
//
// XLINK configuration file for MSP430FR2155
//
// Copyright 1996-2019 IAR Systems AB.
//
// See the file 430/doc/licenses/IARSourceLicense.txt for detailed
// license information.
//
// $Revision: 15384 $
//
// ************************************************

// ---------------------------------------------------------
// Description
//

//
// Usage:
//
//   xlink [file file ...] -f lnk430fr2155.xcl
//
// -----------------------------------------------
// Device summary
//

//
// Core:                               MSP430Xv2
//
// Special vectors:                    47
//
// BSL I2CADDRESS memory:              2 Bytes
//
// BSL Configuration memory:           2 Bytes
//
// BSL Configuration Signature memory: 2 Bytes
//
// JTAG Signature memory:              4 Bytes
//
// BSL Signature memory:               4 Bytes
//
// Peripheral units:                   00100-00FFF
//
// Information memory (FRAM):          01800-019FF
//
// Read/write memory (RAM):            02000-02FFF
//
// Read/write memory (TINYRAM):        00006-0001F
//
// Persistent memory (FRAM):           08000-0FFFF
//


// -----------------------------------------------
// Segments
//

// -------------------------------------
// Data read/write segments
//

//
// The following segments are available for both
// the DATA16 and DATA20 segment groups.
//
// segment         Usage
// -------         --------------------------
// DATA<nn>_Z      Data initialized to zero
// DATA<nn>_I      Data initialized by copying from DATA<nn>_ID
// DATA<nn>_N      Data defined using __no_init
// DATA<nn>_P      Data defined using __persistent
// DATA<nn>_HEAP   The heap used by 'malloc' and 'free'
//
// segment         Usage
// -------         --------------------------
// CSTACK          Runtime stack
// TLS16_I         Thread-local storage for main thread
//


// -------------------------------------
// Program and data read-only segments
//

//
// The following segments are available for both
// the DATA16 and DATA20 segment groups.
//
// segment         Usage
// -------         --------------------------
// DATA<nn>_C      Constant data, including string literals
// DATA<nn>_ID     Initializers for DATA<nn>_I
//
// segment         Usage
// -------         --------------------------
// INFO            Information memory
// CSTART          Program startup code
// CODE            Program code
// ISR_CODE        Program code for interrupt service routines
// DIFUNCT         Dynamic initialization vector used by C++
// CHECKSUM        Checksum byte(s) generated by the -J option
// BSLCONFIGURATIONSIGNATURE BSL Configuration Signature memory
// BSLCONFIGURATION BSL Configuration memory
// BSLI2CADDRESS   BSL I2CADDRESS memory
// JTAGSIGNATURE   JTAG Signature memory
// BSLSIGNATURE    BSL Signature memory
// INTVEC          Interrupt vectors
// RESET           The reset vector
// TLS16_ID        Thread-local initializers for main thread
//
// Notes:
//
// * The segments CSTART, ISR_CODE, and DIFUNCT, as well as the segments in
//   the DATA16 and TLS16 segment groups must be placed in in the range
//   0000-FFFD.
//
// * The INTVEC and RESET segments overlap. This allows an application to
//   either use the reset vector provided by the runtime library, or
//   provide a reset function by defining an interrupt function associated
//   with the reset vector.
//


// ---------------------------------------------------------
// Configuation
//

// -----------------------------------------------
// Stack and heap sizes
//

// Uncomment for command line use
//-D_STACK_SIZE=160
//-D_DATA16_HEAP_SIZE=160
//-D_DATA20_HEAP_SIZE=160


// -----------------------------------------------
// Define cpu
//

-cmsp430


// -----------------------------------------------
// Support for placing functions in read/write memory
//

-QCODE_I=CODE_ID


// -----------------------------------------------
// Support for thread local storage
//

-QTLS16_I=TLS16_ID


// -----------------------------------------------
// Hardware multiplier location
//

-D__iar_HWMUL=4C0


// ---------------------------------------------------------
// Placement directives
//

// -----------------------------------------------
// Information memory
//

-Z(CONST)INFO=1800-19FF
-Z(DATA)DATA16_N=1800-19FF


// -----------------------------------------------
// RAM memory
//

-Z(DATA)TINYRAM=0006-001F
-Z(DATA)DATA16_I,DATA16_Z,TLS16_I=2000-2FFF
-Z(DATA)CODE_I
-Z(DATA)DATA20_I,DATA20_Z,DATA20_N
-Z(DATA)CSTACK+_STACK_SIZE#


// -----------------------------------------------
// FRAM memory
//

// -------------------------------------
// Read/write data in FRAM
//

-Z(CONST)FRWP_B1,DATA16_P,DATA20_P=8000-CFFF
-Z(DATA)DATA16_HEAP+_DATA16_HEAP_SIZE,DATA20_HEAP+_DATA20_HEAP_SIZE,FRWP_B2

// -------------------------------------
// Constant data
//

-Z(CONST)DATA16_C,DATA16_ID,TLS16_ID,DIFUNCT,CHECKSUM=8000-CFFF
-Z(CONST)DATA20_C,DATA20_ID

// -------------------------------------
// Code
//

-Z(CODE)CSTART,ISR_CODE,CODE_ID=8000-CFFF
-P(CODE)CODE,CODE16=8000-CFFF

// -------------------------------------
// Special vectors
//

-Z(CONST)BSLCONFIGURATIONSIGNATURE=FF88-FF89
-Z(CONST)BSLCONFIGURATION=FF8A-FF8B
-Z(CONST)BSLI2CADDRESS=FFA0-FFA1
-Z(CONST)JTAGSIGNATURE=FF80-FF83
-Z(CONST)BSLSIGNATURE=FF84-FF87
-Z(CODE)INTVEC=FFA2-FFFF
-Z(CODE)RESET=FFFE-FFFF
